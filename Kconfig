## Kconfig
```kconfig
config MACROPAD_LEDS
    bool "Macropad per-action LED effects"
    depends on !ZMK_RGB_UNDERGLOW
    select LED_STRIP
    select ZMK_LOW_PRIORITY_WORK_QUEUE
    help
      Drives the LED strip chosen as zmk,underglow with the per-key effects
      from the original macropad firmware. Replaces ZMK's RGB underglow.

if MACROPAD_LEDS

config MACROPAD_LEDS_BRIGHTNESS
    int "Global LED brightness in percent"
    range 1 100
    default 35
    help
      Scales every pixel. 23 LEDs at 100 % can draw well over the 500 mA a
      USB port supplies, so keep this low when powering the strip from USB.

config MACROPAD_LEDS_FRAME_MS
    int "Milliseconds between animation frames"
    range 10 200
    default 30

endif

config MACROPAD_STATUS_RPC
    bool "Expose battery and power status over the custom Studio RPC"
    depends on ZMK_STUDIO && ZMK_BATTERY_REPORTING
    default y
    help
      Registers the macropad__status custom subsystem, which the configurator
      reads to show the battery level over USB or Bluetooth.

config MACROPAD_STATUS_LED
    bool "Show Bluetooth and battery state on an RGB LED"
    depends on ZMK_BLE
    select PWM if !$(dt_nodelabel_enabled,status_pixel)
    select LED_STRIP if $(dt_nodelabel_enabled,status_pixel)
    default y
    help
      Drives the status_led_red, status_led_green and status_led_blue PWM
      LEDs, or the addressable LED labelled status_pixel if the board has
      one: a fast blink while the selected Bluetooth profile is waiting to be
      paired and a short flash every two seconds while a paired host is not
      connected; otherwise green on USB power and red on battery.

config MACROPAD_STATUS_LED_BRIGHTNESS
    int "Status LED brightness in percent"
    depends on MACROPAD_STATUS_LED
    range 1 100
    default 15

config MACROPAD_BT_LED
    bool "Show Bluetooth state on a single LED"
    depends on ZMK_BLE && !MACROPAD_STATUS_LED
    help
      For boards with no pins free for the RGB status LED. Blinks the LED
      named by bt-led-gpios in the zephyr,user node: fast while the selected
      profile is waiting to be paired, a short flash every two seconds while a
      paired host is not connected.

config MACROPAD_BLE_EXCLUSIVE
    bool "Disconnect the other Bluetooth profiles when switching profiles"
    depends on ZMK_BLE
    help
      ZMK keeps hosts on inactive profiles connected, so a computer you
      switched away from still shows the pad as connected. With this, only
      the selected profile stays connected; switching back reconnects it.

config MACROPAD_VIA
    bool "VIA compatibility over USB raw HID"
    depends on ZMK_USB && ZMK_KEYMAP_SETTINGS_STORAGE
    help
      Adds a raw HID interface on USB (and Bluetooth, MACROPAD_VIA_BLE) and
      answers the VIA app's protocol on it, so usevia.app can read and remap
      keys and the knob and edit VIA macros. Needs
      CONFIG_USB_HID_DEVICE_COUNT=2. See via/README.md.

if MACROPAD_VIA

config MACROPAD_VIA_BLE
    bool "VIA over Bluetooth too"
    depends on ZMK_BLE
    default y
    help
      Adds a second Bluetooth HID service with the same raw HID interface,
      so VIA can also reach the pad over Bluetooth. A computer that paired
      before this was added may need to remove and re-pair the pad.

config MACROPAD_VIA_REQUIRE_UNLOCK
    bool "Only accept VIA changes while ZMK Studio is unlocked"
    depends on ZMK_STUDIO
    default y
    help
      VIA has no lock of its own, so without this any program on the
      computer could remap the pad. Reading the keymap is always allowed.

config MACROPAD_VIA_MACRO_COUNT
    int "Number of VIA macros"
    range 1 128
    default 16

config MACROPAD_VIA_MACRO_BUFFER_SIZE
    int "Bytes for all VIA macros together"
    range 64 2048
    default 512

config MACROPAD_VIA_MACRO_TAP_MS
    int "Milliseconds between key events when playing a VIA macro"
    range 1 100
    default 10

endif

config MACROPAD_BOOT_KEY
    bool "Hold a key while powering up to enter the bootloader"
    select GPIO
    help
      Restarts into the UF2 bootloader when the key at
      MACROPAD_BOOT_KEY_ROW/COL (kscan row and column indexes) is held while
      the board starts, so new firmware can be flashed without reaching the
      reset pins. Assumes col2row diodes.

if MACROPAD_BOOT_KEY

config MACROPAD_BOOT_KEY_ROW
    int "Row index of the boot key"
    default 0

config MACROPAD_BOOT_KEY_COL
    int "Column index of the boot key"
    default 1

endif

config MACROPAD_IR
    bool "Infrared transmitter (&ir behavior)"
    select NRFX_PWM2
    help
      Sends TV, AC and other remote-control codes on the pin named by
      ir-gpios in the zephyr,user node (driving an IR LED's transistor,
      high = on). Keys bound to &ir IR_POWER, &ir IR_VOL_UP and so on send
      that function from the active code set; IR_SLOT_NEXT cycles sets.
      Uses the nRF PWM2 peripheral, so nothing else may use pwm2.

if MACROPAD_IR

config MACROPAD_IR_SLOTS
    int "Number of stored IR code sets"
    range 1 8
    default 4

config MACROPAD_IR_MAX_PERIODS
    int "Longest IR burst, in carrier periods"
    default 6144
    help
      Two bytes of RAM each. Sony's three 45 ms frames at 40 kHz need about
      5400; NEC needs about 2600.

config MACROPAD_IR_REPEAT_DELAY_MS
    int "Hold time before a repeatable IR function repeats"
    default 400

config MACROPAD_IR_REPEAT_MS
    int "Interval between repeats while held"
    default 110

endif
```

## boards/shields/macropad/Kconfig.defconfig
```kconfig
if SHIELD_MACROPAD

config ZMK_KEYBOARD_NAME
    default "Macropad"

config EC11
    default y

config EC11_TRIGGER_GLOBAL_THREAD
    default y

endif
```

## boards/shields/tvremote/Kconfig.defconfig
```kconfig
if SHIELD_TVREMOTE || SHIELD_TVREMOTE_FINDER

config ZMK_KEYBOARD_NAME
    default "TV Remote"

endif
```

## boards/shields/tvremote/Kconfig.shield
```kconfig
config SHIELD_TVREMOTE
    def_bool $(shields_list_contains,tvremote)

config SHIELD_TVREMOTE_FINDER
    def_bool $(shields_list_contains,tvremote_finder)
```

## dts/bindings/behaviors/zmk,behavior-ir.yaml
```yaml
# SPDX-License-Identifier: MIT

description: Sends an IR code from the active code set (src/ir)

compatible: "zmk,behavior-ir"

include: one_param.yaml
```

## dts/bindings/behaviors/zmk,behavior-lightbar-mode.yaml
```yaml
# SPDX-License-Identifier: MIT

description: Switches the light bar between RGB effects and status (src/macropad_lightbar.c)

compatible: "zmk,behavior-lightbar-mode"

include: zero_param.yaml
```

## dts/bindings/behaviors/zmk,behavior-status-led-toggle.yaml
```yaml
# SPDX-License-Identifier: MIT

description: Turns the status LED off and on (src/macropad_status_led.c)

compatible: "zmk,behavior-status-led-toggle"

include: zero_param.yaml
```

## dts/bindings/behaviors/zmk,behavior-via-macro.yaml
```yaml
# SPDX-License-Identifier: MIT

description: Types a VIA macro (src/via/via_macros.c)

compatible: "zmk,behavior-via-macro"

include: one_param.yaml
```
