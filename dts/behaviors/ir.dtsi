/*
 * SPDX-License-Identifier: MIT
 */

#include <dt-bindings/zmk/ir.h>

/ {
    behaviors {
        ir: ir {
            compatible = "zmk,behavior-ir";
            #binding-cells = <1>;
            display-name = "Infrared";
        };
    };
};
