/*
 * SPDX-License-Identifier: MIT
 */

/ {
    behaviors {
        sl_tog: sl_tog {
            compatible = "zmk,behavior-status-led-toggle";
            #binding-cells = <0>;
            display-name = "Status LED";
        };
    };
};
