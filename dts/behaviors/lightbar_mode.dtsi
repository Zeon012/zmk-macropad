/*
 * SPDX-License-Identifier: MIT
 */

/ {
    behaviors {
        lb_mode: lb_mode {
            compatible = "zmk,behavior-lightbar-mode";
            #binding-cells = <0>;
            display-name = "Light Bar Mode";
        };
    };
};
